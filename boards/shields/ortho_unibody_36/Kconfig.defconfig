## boards/shields/ortho_unibody_36/Kconfig.defconfig
```kconfig
if SHIELD_ORTHO_UNIBODY_36

config ZMK_KEYBOARD_NAME
    default "Ortho Unibody 36"

endif
```

## boards/shields/ortho_unibody_36/Kconfig.shield
```kconfig
config SHIELD_ORTHO_UNIBODY_36
    def_bool $(shields_list_contains,ortho_unibody_36)
```

## boards/shields/split36/Kconfig.defconfig
```kconfig
if SHIELD_SPLIT_3X5_3_LEFT

config ZMK_KEYBOARD_NAME
    default "Split 3x5+3 Left"

config ZMK_SPLIT_ROLE_CENTRAL
    default y

endif

if SHIELD_SPLIT_3X5_3_RIGHT

config ZMK_KEYBOARD_NAME
    default "Split 3x5+3 Right"

endif

if SHIELD_SPLIT_3X5_3_LEFT || SHIELD_SPLIT_3X5_3_RIGHT

config ZMK_SPLIT
    default y

endif
```

## boards/shields/split_3x5_3/Kconfig.shield
```kconfig
config SHIELD_SPLIT_3X5_3_LEFT
    def_bool $(shields_list_contains,split_3x5_3_left)

config SHIELD_SPLIT_3X5_3_RIGHT
    def_bool $(shields_list_contains,split_3x5_3_right)
```
